## conf/layer.conf
```bitbake
# We have a conf and classes directory, add to BBPATH
BBPATH .= ":${LAYERDIR}"

# We have recipes-* directories, add to BBFILES
BBFILES += "${LAYERDIR}/recipes-*/*/*.bb \
	${LAYERDIR}/recipes-*/*/*.bbappend"

BBFILE_COLLECTIONS += "ccimx6ulsbc_emmc"
BBFILE_PATTERN_ccimx6ulsbc_emmc = "^${LAYERDIR}/"
BBFILE_PRIORITY_ccimx6ulsbc_emmc = "6"

LAYERSERIES_COMPAT_ccimx6ulsbc_emmc = "gatesgarth"
```
